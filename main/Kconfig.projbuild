## main/Kconfig.projbuild
```kconfig
menu "Main Configuration"
    
    # Configuration options for the Wi-Fi station
    menu "Wi-Fi Config"
        config WIFI_SSID
            string "Wi-Fi SSID"
            default "myssid"
            help
                SSID (network name) for the controller to connect to

        config WIFI_PASS
            string "Wi-Fi Password"
            default "mypassword"
            help
                Wi-Fi password for the network

        config WIFI_MAX_CONNECTION_ATTEMPTS
            int "Max initial connection attempts"
            default 5
            help
                Maximum number of times the device will try to connect to the
                wifi when it's powered up. If set to 0, the device will try to
                connect to the wifi forever.

        config WIFI_MAX_RECONNECT_ATTEMPTS
            int "Max reconnection attempts"
            default 0
            help
                Maximum number of times the device will try to reconnect to the
                wifi after it loses connection. If set to 0, the device will try
                to reconnect to the wifi forever.
        
        config WIFI_CONNECT_RETRY_DELAY_MS
            int "Connection retry delay (ms)"
            default 5000
            help
                Time delay in milliseconds the device waits before trying to
                connect to the Wi-Fi network again
    endmenu

    # Configuration for MQTT
    menu "MQTT Config"
        config MQTT_BROKER_URL
            string "Broker URL"
            default "mqtt://core-mosquitto.local:1883"
            help
                URL of the MQTT broker. Port number should be specified with it.

        config MQTT_CLIENT_USER
            string "Client Username"
            default "mqttuser"
            help
                Username of the MQTT client

        config MQTT_CLIENT_PASS
            string "Client Password"
            default "mqttpass"
            help
                Password of the MQTT client
    endmenu

    # Configuration for the LED strip
    menu "LED Strip Config"
        config LED_STRIP_GPIO_PIN
            int "GPIO pin"
            default 0
            help
                GPIO pin the LED strip is connected to

        config LED_STRIP_LED_COUNT
            int "Number of LEDs"
            default 1
            help
                Number of LEDs in the strip

        config LED_STRIP_MAX_BRIGHTNESS
            int "Max brightness"
            default 255
            help
                Maximum brightness value that the LED strip can be set to

        config LED_STRIP_MAX_KELVIN
            int "Max Kelvin"
            default 6000
            help
                Maximum Kelvin rating of the LED strip
        
        config LED_STRIP_MIN_KELVIN
            int "Min Kelvin"
            default 3000
            help
                Minimum Kelvin rating of the LED strip
    endmenu

endmenu
```
